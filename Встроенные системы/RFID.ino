#include <Servo.h> //подключаем библиотеку для работы с сервоприводом
#include <SPI.h> //подключаем библиотеку
#include <MFRC522.h> //подключаем библиотеку №2
MFRC522 mfrc522(10, 9); //указываем порты подключения модуля и называем его "mfrc522"
Servo one; //даем имя сервоприводу "one"
void setup() {
one.attach(4); //указываем порт подключения сервопривода
SPI.begin(); //инициализируем интерфейс
pinMode(2, OUTPUT); //указываем режим порта, как выход
pinMode(3, OUTPUT); //указываем режим порта, как выход
mfrc522.PCD_Init(); //инициализируем модуль RFID-RC522 со своим именем "mfrc522"
}
void loop() {
one.write(0); //поворачиваем вал сервопривода в положение 0 градусов
digitalWrite(2, LOW); //выключаем синий светодиод
digitalWrite(3, HIGH); //включаем красный светодиод
byte uidCard[4] = {0x40, 0xA4, 0x9D, 0x1B}; //указываем номер "ключ" карты "у каждого индивидуальный"
if ( ! mfrc522.PICC_IsNewCardPresent()) { //если новой карты нет, то перезапустить цикл "void loop"
  return;
}
if ( ! mfrc522.PICC_ReadCardSerial()) { //если данные карты не читаются, то перезапустить цикл "void loop"
  return;
}
for (byte i = 0; i < 4; i++) { //Сверяем два массива, если какой то байт не совпал, выходим из цикла. Если все верно, то выполняем действия после цикла.
  if (uidCard[i] != mfrc522.uid.uidByte[i])
  return;
}
digitalWrite(3, LOW); //выключаем красный светодиод
digitalWrite(2, HIGH); //включаем синий светодиод
one.write(180); //поворачиваем вал сервопривода на 180 градусов
delay(2500); //задержка 5000 миллисекунд
}
